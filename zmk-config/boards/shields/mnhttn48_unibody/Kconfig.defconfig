## zmk-config/boards/shields/mnhttn48_unibody/Kconfig.defconfig
```kconfig
if SHIELD_MNHTTN48_UNIBODY

config ZMK_KEYBOARD_NAME
    default "mnhTTn48 unibody"

endif
```

## zmk-config/boards/shields/mnhttn48_unibody/Kconfig.shield
```kconfig
config SHIELD_MNHTTN48_UNIBODY
    def_bool $(shields_list_contains,mnhttn48_unibody)
    select SPI
```
